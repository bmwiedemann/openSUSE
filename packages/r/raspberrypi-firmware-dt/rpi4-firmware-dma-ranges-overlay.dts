/*
 * The firmware bus is virtual and devices have to inherit their DMA
 * constraints from the underlying interconnect. So add an empty dma-ranges
 * property to the bus node, implying the firmware bus' DMA constraints are
 * identical to its parent's.
 *
 * This was sent upstream and will be removed when available.
 */
/dts-v1/;
/plugin/;

/{
	compatible = "brcm,bcm2711";

	fragment@0 {
		target = <&firmware>;
		__overlay__ {
			dma-ranges;
		};
	};
};
